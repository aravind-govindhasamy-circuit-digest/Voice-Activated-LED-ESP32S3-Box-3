## main/Kconfig.projbuild
```kconfig
menu "Project Configuration"

    config EXAMPLE_WIFI_SSID
        string "WiFi SSID"
        default ""
        help
            SSID of the WiFi network to connect to.

    config EXAMPLE_WIFI_PASSWORD
        string "WiFi Password"
        default ""
        help
            Password of the WiFi network to connect to.

    config EXAMPLE_MQTT_BROKER_URL
        string "MQTT Broker URL"
        default ""
        help
            URL of the MQTT broker to connect to.
            e.g. mqtt://192.168.1.100 or mqtt://example.com

    config EXAMPLE_MQTT_USERNAME
        string "MQTT Username"
        default ""
        help
            Username for MQTT broker authentication.

    config EXAMPLE_MQTT_PASSWORD
        string "MQTT Password"
        default ""
        help
            Password for MQTT broker authentication.

    config EXAMPLE_MQTT_USER_ID
        string "MQTT User ID"
        default "16e6f1d6-9ac5-4825-bec0-c79107d09490"
        help
            User ID for topic structure (cd/users/16e6.../devices/...).

    config EXAMPLE_MQTT_DEVICE_ID
        string "MQTT Device ID"
        default "CD_BOX_3_V1"
        help
            Device ID for topic structure and username.

    config EXAMPLE_MQTT_CLIENT_ID
        string "MQTT Client ID"
        default "32ea3b2c-1c49-4fcc-87d9-db8c11148574"
        help
            Client ID for MQTT connection.

    config EXAMPLE_MQTT_PORT
        int "MQTT Port"
        default 1883
        help
            Port of the MQTT broker.

endmenu
```
